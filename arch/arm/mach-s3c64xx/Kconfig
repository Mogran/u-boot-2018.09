## arch/arm/mach-s3c64xx/Kconfig
```kconfig
if ARCH_S3C64XX

choice
	prompt "Choice your board lml6410 or tiny6410"
	optional

config TARGET_LML6410
	bool "Support lml 6410 board"
	select OF_CONTROL

endchoice

config SYS_TEXT_BASE
	default 0x30008000


source "board/samsung/lml6410/Kconfig"

endif
```

## board/samsung/lml6410/Kconfig
```kconfig
if TARGET_LML6410

config SYS_BOARD
	default "lml6410"

config SYS_VENDOR
	default "samsung"

config SYS_SOC
	default "s3c64xx"

config SYS_CONFIG_NAME
	default "lml6410"

endif
```
